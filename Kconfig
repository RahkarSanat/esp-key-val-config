## Kconfig
```kconfig
menu "Key Value Config"

config KVC_BASE_PATH
  string "Base Path"
  default "/configs"
  help
    File path prefix associated with the filesystem.

config KVC_MAX_FILES
  int "Max Config Files"
  range 1 100
  default 5
  help
    Maximum number of config files to work with.

config KVC_MAX_FILE_LEN
  int "Max File Length"
  range 200 10000
  default 512
  help
    Maximum number of bytes that store on a config file.

config KVC_MAX_LINE_LEN
  int "Max Line Length"
  range 3 256
  default 64
  help
    Maximum number of bytes that key and value will use.

endmenu
```
